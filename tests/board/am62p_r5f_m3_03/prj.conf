## CMakeLists.txt
```
# SPDX-License-Identifier: Apache-2.0
#
# M3-03 board scenes 9 to 12 on the Verdin AM62P's MCU R5F
# (docs/m3-03-board-test-design.md). A separate application next to
# tests/board/am62p_r5f: it builds the same way, with the same board, SoC
# and DSS driver from yakogl and the demo module passed in ZEPHYR_MODULES
# (docs/board-test-am62p-r5f.md); nothing of them is in this repository.
#
# DRAFT: never built here. Not built for or run on a board; no hardware
# result. The host check is scripts/check-am62p-m3-03-c.sh.

cmake_minimum_required(VERSION 3.20.0)

find_package(Zephyr REQUIRED HINTS $ENV{ZEPHYR_BASE})
project(hwlayer_board_am62p_r5f_m3_03 C)

get_filename_component(HWLAYER_ROOT ${CMAKE_CURRENT_LIST_DIR}/../../.. ABSOLUTE)
# The eight-scene app: its driver binding is used by path, not copied, and
# its scenes.h gives the colours and the rectangle.
set(AM62P_R5F_APP ${HWLAYER_ROOT}/tests/board/am62p_r5f)

# The engine, built as in tests/board/am62p_r5f/CMakeLists.txt: the static
# library of composition-ffi-staticlib, no std, with its own panic handler,
# for the R5F (Armv7-R, hard-float ABI: prj.conf sets CONFIG_FPU and
# CONFIG_FP_HARDABI to match). Cargo decides whether it is up to date.
set(CE_RUST_TARGET armv7r-none-eabihf)
set(CE_CARGO_TARGET_DIR ${CMAKE_BINARY_DIR}/cargo)
set(CE_LIBRARY ${CE_CARGO_TARGET_DIR}/${CE_RUST_TARGET}/release/libcomposition_engine.a)

add_custom_target(composition_engine_build
  COMMAND cargo build --locked --release
          -p composition-ffi-staticlib --no-default-features --features panic-handler
          --target ${CE_RUST_TARGET} --target-dir ${CE_CARGO_TARGET_DIR}
  WORKING_DIRECTORY ${HWLAYER_ROOT}
  BYPRODUCTS ${CE_LIBRARY}
  USES_TERMINAL
  VERBATIM)

add_library(composition_engine STATIC IMPORTED GLOBAL)
set_target_properties(composition_engine PROPERTIES IMPORTED_LOCATION ${CE_LIBRARY})
add_dependencies(composition_engine composition_engine_build)

target_sources(app PRIVATE
  src/main.c
  src/m3_03_scenes.c
  ${AM62P_R5F_APP}/src/hw_am62p.c
  ${HWLAYER_ROOT}/backends/twoplane/ce_twoplane.c)

target_include_directories(app PRIVATE
  src
  ${AM62P_R5F_APP}/src
  ${HWLAYER_ROOT}/backends/twoplane
  ${HWLAYER_ROOT}/crates/composition-ffi/include)

# Overridable at configuration, as in tests/board/am62p_r5f. The scenes'
# own timing, sweep and burst parameters are the M3_* macros at the top of
# src/m3_03_scenes.c (all to be chosen on the board); pass them with
# -DEXTRA_CFLAGS or add them here once chosen.
set(TEST_APP_MAX_WIDTH 1280 CACHE STRING "Application buffer width, pixels")
set(TEST_APP_MAX_HEIGHT 800 CACHE STRING "Application buffer height, pixels")
set(TEST_HOLD_MS 5000 CACHE STRING "Time each photographed state is held, ms")
target_compile_definitions(app PRIVATE
  TEST_APP_MAX_WIDTH=${TEST_APP_MAX_WIDTH}
  TEST_APP_MAX_HEIGHT=${TEST_APP_MAX_HEIGHT}
  TEST_HOLD_MS=${TEST_HOLD_MS})

target_link_libraries(app PRIVATE composition_engine)
```

## prj.conf
```kconfig
# SPDX-License-Identifier: Apache-2.0
#
# M3-03 board scenes 9 to 12 on the Verdin AM62P's MCU R5F, started from the
# board's Linux through remoteproc while Linux keeps running, like
# tests/board/am62p_r5f (docs/board-test-am62p-r5f.md). The same settings
# as that app's prj.conf plus a larger console buffer; nothing here has been
# built yet.

# The console is a RAM buffer that the SoC's resource table offers to Linux
# as the remote processor's trace buffer; Linux keeps the UART.
CONFIG_SERIAL=n
CONFIG_UART_CONSOLE=n
CONFIG_RAM_CONSOLE=y
CONFIG_PRINTK=y
# The buffer is a ring (default 1024 bytes) and these scenes print about
# 80 lines, some 7 KB on the host run (more with M3_SWEEP_* raised): too
# small a ring loses the start.
# The size is to be chosen on the board (what the R5F's memory holds).
CONFIG_RAM_CONSOLE_BUFFER_SIZE=16384

CONFIG_WATCHDOG=n
CONFIG_I2C=y
CONFIG_GPIO=y

# The engine is built for armv7r-none-eabihf: the image uses the hard-float
# ABI too.
CONFIG_FPU=y
CONFIG_FP_HARDABI=y

# ce_present and ce_poll_event run on the main thread; scene 10 busy-waits
# on it (k_busy_wait) between two presents.
CONFIG_MAIN_STACK_SIZE=16384
```

## src/main.c
```c
/*
 * SPDX-License-Identifier: Apache-2.0
 *
 * M3-03 board scenes 9 to 12 on the Verdin AM62P's MCU R5F: the sequence
 * (m3_03_scenes.c) on the two-plane backend (backends/twoplane), bound to
 * the demo module's DSS driver (../am62p_r5f/src/hw_am62p.c), with Zephyr
 * as the port. The console is printk, as in tests/board/am62p_r5f.
 *
 * DRAFT: not built for or run on a board; no hardware result.
 */
#include <zephyr/cache.h>
#include <zephyr/device.h>
#include <zephyr/kernel.h>
#include <zephyr/sys/printk.h>
#include <mcui/am62p_dss.h>
#include <mcui/panel_sn65dsi83.h>

#include "m3_03.h"

#ifndef TEST_APP_MAX_WIDTH
#define TEST_APP_MAX_WIDTH 1280
#endif
#ifndef TEST_APP_MAX_HEIGHT
#define TEST_APP_MAX_HEIGHT 800
#endif
#ifndef TEST_HOLD_MS
#define TEST_HOLD_MS 5000
#endif

/* The demo module's DSS driver, as struct ce_twoplane_hw (hw_am62p.c). */
extern const struct ce_twoplane_hw ce_twoplane_hw_am62p;

static const struct device *const display = DEVICE_DT_GET(DT_CHOSEN(zephyr_display));
/* The panel whose backlight this core may switch, if the board has one. */
static const struct device *const panel = DEVICE_DT_GET_ANY(mcui_sn65dsi83_lvds_panel);

/* Given at every vsync (port wake), taken by the thread that polls the engine. */
static K_SEM_DEFINE(vsync_sem, 0, 1);

/* The application frames, RGB565 at the panel's size, as in
 * tests/board/am62p_r5f. Whether this region is cached by the R5F is what
 * scene 12 asks; the MPU attributes are to be read on the board.
 */
static uint16_t app_mem[2][TEST_APP_MAX_WIDTH * TEST_APP_MAX_HEIGHT] __aligned(64);

static unsigned int port_irq_lock(void)
{
	return irq_lock();
}

static void port_irq_unlock(unsigned int key)
{
	irq_unlock(key);
}

static void port_wake(void *arg)
{
	k_sem_give(arg);
}

static bool port_device_ready(const void *dev)
{
	return device_is_ready(dev);
}

static void env_wait_wake(uint32_t ms)
{
	(void)k_sem_take(&vsync_sem, K_MSEC(ms));
}

/* The timer's resolution bounds scene 10's offsets: to be read on the board. */
static uint64_t env_now_us(void)
{
	return k_ticks_to_us_floor64((uint64_t)k_uptime_ticks());
}

static void env_delay_us(uint32_t us)
{
	k_busy_wait(us);
}

static void env_hold(uint32_t ms, unsigned scene, const struct m3_view *expect)
{
	(void)scene;
	(void)expect; /* printed by the sequence as a HOLD line */
	k_msleep(ms);
}

static int env_flush(void *p, size_t len)
{
	return sys_cache_data_flush_range(p, len);
}

int main(void)
{
	const struct m3_env env = {
		.hw = &ce_twoplane_hw_am62p,
		.dev = display,
		.irq_lock = port_irq_lock,
		.irq_unlock = port_irq_unlock,
		.wake = port_wake,
		.wake_arg = &vsync_sem,
		.device_ready = port_device_ready,
		.wait_wake = env_wait_wake,
		.now_us = env_now_us,
		.delay_us = env_delay_us,
		.hold = env_hold,
		.flush = env_flush,
		.log = printk,
		.app_mem = {app_mem[0], app_mem[1]},
		.app_size = sizeof(app_mem[0]),
		.hold_ms = TEST_HOLD_MS,
		.host_fake = false,
	};

	/* As tests/board/am62p_r5f: start the panel's timing, then the backlight
	 * (a no-op where Linux holds it).
	 */
	int rc = am62p_dss_output_enable(display, true);

	printk("board test m3-03: output enable %d\n", rc);
	if (panel != NULL && device_is_ready(panel)) {
		rc = panel_sn65dsi83_backlight(panel, true);
		printk("board test m3-03: backlight %d\n", rc);
	}

	(void)m3_03_run(&env);

	/* Idle with the last state on the panel. */
	for (;;) {
		k_sleep(K_FOREVER);
	}
	return 0;
}
```

## src/m3_03.h
```c
/* SPDX-License-Identifier: Apache-2.0 */
/*
 * M3-03 board scenes 9 to 12 (docs/m3-03-board-test-design.md): the
 * producer stops and restarts, a safety flip on top of an in-flight
 * application commit, back-to-back commits within one frame, and cache
 * maintenance. They run through the engine's C API (composition_engine.h)
 * on the two-plane backend (backends/twoplane), like scenes 1 to 8 of
 * tests/board/am62p_r5f, and print SCENE and RESULT lines in the same form.
 *
 * DRAFT: compiled and run on the host behind the fake panel only
 * (scripts/check-am62p-m3-03-c.sh). Not built for or run on a board.
 *
 * Like scenes.c, the sequence uses no operating system and no C library
 * beyond <stdbool.h>, <stddef.h> and <stdint.h>: the firmware (main.c) and
 * the host program (host/m3_03_host.c) give it the driver, the system and
 * the memory through struct m3_env.
 */
#ifndef M3_03_H_
#define M3_03_H_

#include <stdbool.h>
#include <stddef.h>
#include <stdint.h>

#include "ce_twoplane.h"
/* The colours and the rectangle of scenes 1 to 8 (tests/board/am62p_r5f),
 * so that the photographs of both apps are judged the same way.
 */
#include "scenes.h"

/* Colours added for scenes 9 to 12, RGB565. */
#define M3_APP_YELLOW  0xFFE0u /* a third application colour */
#define M3_APP_MAGENTA 0xF81Fu /* the half-drawn part in 9a: must never be on the panel */
#define M3_APP_WHITE   0xFFFFu /* 12b, drawn without a cache clean */

/* What the panel should show during a hold: the safety layer is clear with
 * the red rectangle on safety_side (SCENES_RECT_LEFT or SCENES_RECT_RIGHT),
 * over the application plane in app_colour, or over black when app_on is
 * false. The firmware only prints it (for the photograph); the host's fake
 * panel compares it with every pixel.
 */
struct m3_view {
	const char *name;
	int safety_side;
	bool app_on;
	uint16_t app_colour;
	/* NULL, or what the photograph has to decide (12b). */
	const char *note;
};

struct m3_env {
	const struct ce_twoplane_hw *hw;
	const void *dev;
	/* The port's system calls (struct ce_twoplane_port); the sequence adds
	 * its own table of buffers as the port's lookup.
	 */
	unsigned int (*irq_lock)(void);
	void (*irq_unlock)(unsigned int key);
	void (*wake)(void *wake_arg);
	void *wake_arg;
	bool (*device_ready)(const void *dev);
	/* Waits for wake() or at most ms milliseconds. */
	void (*wait_wake)(uint32_t ms);
	/* A clock in microseconds that never goes back, and a busy wait on it. */
	uint64_t (*now_us)(void);
	void (*delay_us)(uint32_t us);
	/* Keeps the panel as it is for ms milliseconds; scene is its number and
	 * expect what it should show.
	 */
	void (*hold)(uint32_t ms, unsigned scene, const struct m3_view *expect);
	/* Makes len bytes at p, just drawn, visible to the display controller;
	 * returns 0 or the cache call's error.
	 */
	int (*flush)(void *p, size_t len);
	/* The console, printk-like: %s, %d, %u and %x only. */
	void (*log)(const char *fmt, ...);
	/* Two application buffers of app_size bytes each (RGB565, the panel's
	 * size), at an address the display controller reads as given.
	 */
	void *app_mem[2];
	size_t app_size;
	/* How long each photographed state stays on the panel. */
	uint32_t hold_ms;
	/* true on the host: the fake panel reads the buffers directly, so a
	 * missing cache clean cannot show and scene 12b is skipped.
	 */
	bool host_fake;
};

/* The safety rectangle, the same as scenes_rect() of scenes.c (the host
 * program checks that they agree).
 */
struct scenes_rect m3_rect(uint32_t width, uint32_t height, int side);

/* Runs scenes 9 to 12 once, logs every step and the result line, and
 * returns true for PASS. The panel keeps the last state.
 */
bool m3_03_run(const struct m3_env *env);

#endif /* M3_03_H_ */
```
