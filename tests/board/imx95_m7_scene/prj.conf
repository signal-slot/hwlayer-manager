## CMakeLists.txt
```
# SPDX-License-Identifier: Apache-2.0
#
# The WP3 comparison scene on the i.MX95 Cortex-M7 (upstream Zephyr), driven
# through the composition engine's C ABI and written as docs/trace-format.md
# lines.
#
# Linking the engine is done as in tests/board/imx95_m7_engine: by default
# the build runs cargo to make libcomposition_engine.a for
# thumbv7em-none-eabihf (no std, with the halting panic handler, release),
# into this build directory. To link a library built beforehand instead,
# pass -DCOMPOSITION_ENGINE_LIB=/path/to/libcomposition_engine.a.
cmake_minimum_required(VERSION 3.20.0)

find_package(Zephyr REQUIRED HINTS $ENV{ZEPHYR_BASE})
project(imx95_m7_scene LANGUAGES C)

get_filename_component(REPO_ROOT ${CMAKE_CURRENT_SOURCE_DIR}/../../.. ABSOLUTE)
set(CE_INCLUDE_DIR ${REPO_ROOT}/crates/composition-ffi/include)
set(CE_RUST_TARGET thumbv7em-none-eabihf)

set(COMPOSITION_ENGINE_LIB "" CACHE FILEPATH
  "Prebuilt libcomposition_engine.a; empty to build it with cargo")

if(COMPOSITION_ENGINE_LIB)
  set(CE_LIB ${COMPOSITION_ENGINE_LIB})
  add_custom_target(composition_engine_cargo)
else()
  find_program(CARGO cargo HINTS $ENV{HOME}/.cargo/bin REQUIRED)
  set(CE_CARGO_TARGET_DIR ${CMAKE_BINARY_DIR}/cargo)
  set(CE_LIB ${CE_CARGO_TARGET_DIR}/${CE_RUST_TARGET}/release/libcomposition_engine.a)
  # Always run: cargo itself decides whether anything changed.
  add_custom_target(composition_engine_cargo
    COMMAND ${CMAKE_COMMAND} -E env CARGO_TARGET_DIR=${CE_CARGO_TARGET_DIR}
            ${CARGO} build --locked
            -p composition-ffi-staticlib
            --no-default-features --features panic-handler
            --target ${CE_RUST_TARGET} --release
    WORKING_DIRECTORY ${REPO_ROOT}
    BYPRODUCTS ${CE_LIB}
    COMMENT "cargo build composition-ffi-staticlib (${CE_RUST_TARGET}, no std, release)"
    USES_TERMINAL
  )
endif()

add_library(composition_engine STATIC IMPORTED GLOBAL)
set_target_properties(composition_engine PROPERTIES IMPORTED_LOCATION ${CE_LIB})
add_dependencies(composition_engine composition_engine_cargo)

# The repository revision goes into the hdr line's build= text. Taken at
# configure time; "unknown" outside a git checkout. A "-dirty" suffix marks
# uncommitted changes.
execute_process(
  COMMAND git describe --always --dirty --abbrev=12
  WORKING_DIRECTORY ${REPO_ROOT}
  OUTPUT_VARIABLE SCENE_REPO_REV
  OUTPUT_STRIP_TRAILING_WHITESPACE
  ERROR_QUIET
  RESULT_VARIABLE SCENE_REPO_REV_RESULT
)
if(NOT SCENE_REPO_REV_RESULT EQUAL 0 OR SCENE_REPO_REV STREQUAL "")
  set(SCENE_REPO_REV unknown)
endif()

target_sources(app PRIVATE src/main.c src/trace.c)
target_include_directories(app PRIVATE ${CE_INCLUDE_DIR})
target_compile_definitions(app PRIVATE SCENE_REPO_REV="${SCENE_REPO_REV}")
target_link_libraries(app PRIVATE composition_engine)
```

## Kconfig
```
# SPDX-License-Identifier: Apache-2.0

mainmenu "i.MX95 M7 WP3 comparison scene"

choice IMX95_M7_SCENE_STAGE
	prompt "Stage of the comparison scene (docs/m2-comparison-plan.md section 2)"
	default IMX95_M7_SCENE_STAGE_A

config IMX95_M7_SCENE_STAGE_A
	bool "Stage A: base layer only (one plane)"

config IMX95_M7_SCENE_STAGE_B
	bool "Stage B: base plus the top overlay layer"
	help
	  The stock upstream DPU driver has one plane, so the engine refuses
	  this frame (plan.no_plane). The run then ends after the first
	  refusal: there is nothing to commit.

endchoice

config IMX95_M7_SCENE_ENABLE_DPU
	bool "Drive the DPU (stock socionext,dpu driver, display_write)"
	default n
	help
	  Off by default. Linux owns the DPU on the Verdin iMX95 under its
	  BSP (docs/imx95-zephyr-feasibility.md), and an M7 that programs the
	  same DPU can corrupt Linux's display. With this option off the
	  upstream DPU driver is not built, nothing touches the display, and
	  the backend uses a stub latch (IMX95_M7_SCENE_STUB_LATCH). Turn it
	  on only after confirming the M7 owns the DPU on the board in use.
	  Needs the board target imx95_evk/mimx9596/m7/ddr and its overlay in
	  boards/.

config IMX95_M7_SCENE_STUB_LATCH
	bool
	default y if !IMX95_M7_SCENE_ENABLE_DPU
	help
	  Set when the DPU is not driven. The backend's commit draws nothing
	  and reports the latch at once, so the engine's buffer lifecycle
	  runs, but no "latched" line of such a run comes from a display.
	  The hdr line says "latch=stub" in its board text. A stub log is not
	  a comparison result (docs/m2-linux-zephyr-comparison.md section 5).

config IMX95_M7_SCENE_FRAMES
	int "Number of frames to present"
	default 300
	range 1 1000000
	help
	  The default matches the Linux example m2scene (--frames 300).
	  The comparison plan asks for at least 1000 frames for latency.

config IMX95_M7_SCENE_TOP_ALPHA
	hex "Plane alpha of the top layer (stage B)"
	default 0x8000
	range 0x0 0xffff
	help
	  0x8000 is "one half", the scene's value
	  (crates/composition-core/tests/m2_scene.rs).

config IMX95_M7_SCENE_TRACE_BUFFER_KB
	int "RAM buffer for trace lines in KiB (0 = print each line at once)"
	default 512 if IMX95_M7_SCENE_ENABLE_DPU
	default 0
	range 0 4096
	help
	  With a buffer, lines are formatted into RAM during the run and
	  printed after it, so the console UART does not pace the frames
	  (docs/m2-comparison-plan.md section 4.2). Formatting still runs in
	  the measured path. A line that does not fit is lost and shows as a
	  gap in seq=; the run's RESULT line counts them. With 0, every line
	  is printed when it is made and the console is part of the run.
	  The default buffer needs the DDR target.

config IMX95_M7_SCENE_LATCH_TIMEOUT_MS
	int "Latch timeout and per-frame wait, in milliseconds"
	default 1000
	range 1 60000
	help
	  The comparison plan's watchdog: no latch within this time is a
	  latch_timeout line, and the run stops.

# The upstream driver symbol defaults to y whenever a socionext,dpu node is
# enabled. Override that default (this file is read before Kconfig.zephyr) so
# the driver, and with it the DPU programming at boot, is only present when
# IMX95_M7_SCENE_ENABLE_DPU is set. Same rule as tests/board/imx95_m7_scanout.
# The display subsystem itself follows the same option, so a stub build has
# no empty display library.
config DISPLAY
	default y if IMX95_M7_SCENE_ENABLE_DPU

config DISPLAY_SOCIONEXT_DPU
	default y if IMX95_M7_SCENE_ENABLE_DPU
	default n

source "Kconfig.zephyr"
```

## prj.conf
```kconfig
# Console: printk over the board's console UART. CONFIG_DISPLAY and the DPU
# driver are only built with CONFIG_IMX95_M7_SCENE_ENABLE_DPU=y (see Kconfig).
CONFIG_PRINTK=y

# Trace lines print 64-bit values (seq, t, at, sub).
CONFIG_CBPRINTF_FULL_INTEGRAL=y

# libcomposition_engine.a is built for thumbv7em-none-eabihf, which passes
# floating-point arguments in FPU registers. Without the hard-float ABI the
# link fails on mismatched VFP attributes.
CONFIG_FPU=y
CONFIG_FP_HARDABI=y

# The planner runs on the caller's stack. 16 KiB leaves room for its search
# state; not measured on the target (same margin as imx95_m7_engine).
CONFIG_MAIN_STACK_SIZE=16384
```

## boards/imx95_evk_mimx9596_m7_ddr.overlay
```dts
/* SPDX-License-Identifier: Apache-2.0 */

/*
 * Enable the DPU node of the i.MX95 M7 at the scene's size, 1280x800
 * ARGB8888 (docs/m2-linux-zephyr-comparison.md section 2). The upstream
 * board files only label the node; the driver needs width, height,
 * pixel-format and a display-timings child, which the dtsi does not provide.
 *
 * The timing values are the "typ" column of the original Toradex 10.1"
 * panel in docs/imx95-verdin-lvds-panel.md (read from source there). The
 * sync polarities are placeholders, and no LVDS/LDB route, pin or clock is
 * configured: on the EVK target this is not a working panel setup. It only
 * gives the driver a 1280x800 mode. The node being enabled does not touch
 * the DPU: the driver is only built when CONFIG_IMX95_M7_SCENE_ENABLE_DPU is
 * set (see Kconfig).
 */

#include <zephyr/dt-bindings/display/panel.h>

/ {
	chosen {
		zephyr,display = &dpu;
	};
};

&dpu {
	status = "okay";
	width = <1280>;
	height = <800>;
	pixel-format = <PANEL_PIXEL_FORMAT_ARGB_8888>;

	display-timings {
		compatible = "zephyr,panel-timing";
		clock-frequency = <71100000>;
		hfront-porch = <60>;
		hback-porch = <60>;
		hsync-len = <40>;
		vfront-porch = <7>;
		vback-porch = <7>;
		vsync-len = <9>;
		hsync-active = <0>;
		vsync-active = <0>;
		de-active = <1>;
		pixelclk-active = <0>;
	};
};
```

## src/main.c
```c
/*
 * SPDX-License-Identifier: Apache-2.0
 *
 * The WP3 comparison scene on the i.MX95 Cortex-M7 under upstream Zephyr,
 * driven through the composition engine's C ABI (libcomposition_engine.a,
 * as in tests/board/imx95_m7_engine) and written as docs/trace-format.md
 * lines, so that scripts/trace-to-metrics.py and m2-compare-report.py can
 * read the log next to the Linux one (crates/composition-drm/examples/
 * m2scene.rs).
 *
 * The scene is the one pinned by crates/composition-core/tests/m2_scene.rs
 * (docs/m2-linux-zephyr-comparison.md section 2):
 *   base: buffer 1 (slot 0) or 3 (slot 1), W x H, full output, z 0,
 *         ARGB8888 linear, opaque blend, no plane alpha;
 *   top (stage B only): buffer 2 or 4, W/3 x H/3, ARGB8888,
 *         premultiplied, plane alpha CONFIG_IMX95_M7_SCENE_TOP_ALPHA,
 *         z 1, destination (W*500/1280, H*300/800).
 * Every frame presents the same picture from the other slot.
 *
 * The backend describes the stock Zephyr DPU driver as tests/board/
 * imx95_m7_engine does (one primary plane, RGB565/RGB888/ARGB8888, opaque,
 * no scaling, full output only; read from source, not measured). Its commit
 * either calls display_write() on the DPU, the path of tests/board/
 * imx95_m7_scanout (CONFIG_IMX95_M7_SCENE_ENABLE_DPU=y), or, by default,
 * touches nothing and reports the latch at once
 * (CONFIG_IMX95_M7_SCENE_STUB_LATCH). See README.md.
 *
 * Which line comes from where (the C ABI has no trace hook, so these are
 * written by this file, in the order the core's trace would use):
 *   check     backend check callback, one per candidate the planner tries
 *   validate  after ce_present(): ok with the accepted candidate, or the
 *             planning error; t = when planning ended (commit callback entry)
 *   commit    after ce_present() returns, when planning succeeded
 *   latched / released / dropped / latch_timeout / device_lost /
 *   caps_changed   from ce_poll_event(), stamped when polled
 */
#include <zephyr/kernel.h>
#include <zephyr/sys/printk.h>
#include <zephyr/sys/util.h>
#include <zephyr/version.h>

#if defined(CONFIG_IMX95_M7_SCENE_ENABLE_DPU)
#include <zephyr/device.h>
#include <zephyr/drivers/display.h>
#endif

#include <inttypes.h>
#include <stdbool.h>
#include <stddef.h>
#include <stdint.h>
#include <string.h>

#include "composition_engine.h"
#include "trace.h"

/* Not in the header: DRM's RGB888 (packed 24 bit). */
#define APP_FORMAT_RGB888 CE_FOURCC('R', 'G', '2', '4')

#if defined(CONFIG_IMX95_M7_SCENE_ENABLE_DPU)
#define DISP_NODE DT_CHOSEN(zephyr_display)
#define OUT_W     DT_PROP(DISP_NODE, width)
#define OUT_H     DT_PROP(DISP_NODE, height)
#define LATCH_TEXT "dpu-write-return"
#else
/* The panel size the docs assume (inferred, not measured). */
#define OUT_W      1280
#define OUT_H      800
#define LATCH_TEXT "stub"
#endif

#if defined(CONFIG_IMX95_M7_SCENE_STAGE_B)
#define STAGE_TEXT "B"
#define LAYERS     2
#else
#define STAGE_TEXT "A"
#define LAYERS     1
#endif

#define TOP_W ((OUT_W / 3) > 0 ? (OUT_W / 3) : 1)
#define TOP_H ((OUT_H / 3) > 0 ? (OUT_H / 3) : 1)
#define TOP_X (OUT_W * 500 / 1280)
#define TOP_Y (OUT_H * 300 / 800)

/* Flat, saturated, opaque (premultiplied the same). */
#define COLOR_BASE 0xFF0030C0U

enum { OUT_ID = 0, PLANE_PRIMARY = 1 };

/* Slot s uses base buffer slot_base[s] and top buffer slot_top[s]. */
static const uint32_t slot_base[2] = { 1, 3 };
static const uint32_t slot_top[2] = { 2, 4 };

#if defined(CONFIG_IMX95_M7_SCENE_ENABLE_DPU)
/*
 * Full-frame, 32-byte aligned, pitch-matching buffers take the driver's
 * zero-copy path (as in imx95_m7_scanout). Only the base layer is ever
 * shown: the stock driver has no second plane.
 */
static uint32_t fb[2][OUT_W * OUT_H] __aligned(32);
#endif

struct scene_backend {
#if defined(CONFIG_IMX95_M7_SCENE_ENABLE_DPU)
	const struct device *dev;
#endif
	bool latch_pending;
	uint64_t latch_submission;
	/* Per ce_present() call. */
	bool accepted;
	ce_assignment accepted_assignments[CE_MAX_LAYERS];
	size_t accepted_count;
	uint32_t rejected;
	bool committed;
	uint64_t plan_end;
};

static void scene_capabilities(void *ctx, ce_capabilities *out)
{
	(void)ctx;
	out->output_count = 1;
	/* The refresh rate is not known here: 0. */
	out->outputs[0] = (ce_output_caps){
		.id = OUT_ID, .width = OUT_W, .height = OUT_H, .refresh_mhz = 0,
	};
	out->plane_count = 1;
	out->planes[0] = (ce_plane_caps){
		.id = PLANE_PRIMARY,
		.kind = CE_PLANE_PRIMARY,
		.outputs = 1u << 0,
		.format_count = 3,
		.can_scale = 0,
		.plane_alpha = 0,
		.blend_modes = 1u << CE_BLEND_OPAQUE,
		.transforms = 1u << CE_TRANSFORM_NORMAL,
		.zpos_min = 0,
		.zpos_max = 0,
		.zpos_mutable = 0,
		/* One framebuffer for the whole panel (inferred from the driver). */
		.full_output_only = 1,
	};
	out->planes[0].formats[0] = (ce_format){ CE_MODIFIER_LINEAR, CE_FORMAT_RGB565 };
	out->planes[0].formats[1] = (ce_format){ CE_MODIFIER_LINEAR, APP_FORMAT_RGB888 };
	out->planes[0].formats[2] = (ce_format){ CE_MODIFIER_LINEAR, CE_FORMAT_ARGB8888 };
	/* display_write() blocks until the latch: no replacement. */
	out->replace_pending = 0;
}

static ce_status scene_check(void *ctx, const ce_frame *frame, const ce_assignment *assignments,
			     size_t count)
{
	struct scene_backend *be = ctx;
	uint64_t t = trace_now();
	ce_status result = CE_OK;

	for (size_t i = 0; i < count; i++) {
		if (assignments[i].plane_index != 0 || assignments[i].layer >= frame->layer_count) {
			result = CE_ERR_BACKEND_REJECTED;
		}
	}
	trace_check(t, frame->output, assignments, count, result);
	if (result == CE_OK) {
		/* The planner takes the first candidate the backend accepts. */
		be->accepted = true;
		be->accepted_count = MIN(count, ARRAY_SIZE(be->accepted_assignments));
		memcpy(be->accepted_assignments, assignments,
		       be->accepted_count * sizeof(assignments[0]));
	} else {
		be->rejected++;
	}
	return result;
}

static ce_status scene_commit(void *ctx, uint64_t submission, const ce_frame *frame,
			      const ce_assignment *assignments, size_t count)
{
	struct scene_backend *be = ctx;

	be->plan_end = trace_now();
	be->committed = true;
#if defined(CONFIG_IMX95_M7_SCENE_ENABLE_DPU)
	if (count > 0) {
		uint32_t buffer = frame->layers[assignments[0].layer].buffer;
		const uint32_t *pixels = buffer == slot_base[1] ? fb[1] : fb[0];
		struct display_buffer_descriptor desc = {
			.buf_size = sizeof(fb[0]),
			.width = OUT_W,
			.height = OUT_H,
			.pitch = OUT_W,
		};
		/*
		 * Blocks until the ExtDst0 shadow-load interrupt (read from
		 * source, imx95_m7_scanout README). Its return is the nearest
		 * latch signal the stock driver gives.
		 */
		int ret = display_write(be->dev, 0, 0, &desc, pixels);

		if (ret != 0) {
			/* Passed on as backend.platform errno=<ret>. */
			return ret;
		}
	}
#else
	ARG_UNUSED(frame);
	ARG_UNUSED(assignments);
	ARG_UNUSED(count);
#endif
	be->latch_pending = true;
	be->latch_submission = submission;
	return CE_OK;
}

static bool scene_poll_event(void *ctx, ce_backend_event *out)
{
	struct scene_backend *be = ctx;

	if (!be->latch_pending) {
		return false;
	}
	be->latch_pending = false;
	out->kind = CE_BACKEND_LATCHED;
	out->output = OUT_ID;
	out->submission = be->latch_submission;
	return true;
}

/* Gives the engine the time; the following lines carry it as at=. */
static void advance(ce_engine *engine)
{
	uint64_t now = trace_engine_time();

	trace_set_at(now);
	ce_advance_time(engine, now);
}

struct counters {
	uint32_t committed;
	uint32_t latched;
	uint32_t dropped;
	uint32_t timeouts;
	bool has_on_screen;
	uint64_t on_screen;
};

/*
 * Takes every queued event and writes its line. A released buffer belongs
 * to the submission the latch before it took off screen, or to the dropped
 * submission before it (the attribution rule of engine.rs trace_events).
 * Returns false on an engine error.
 */
static bool drain(ce_engine *engine, struct counters *c)
{
	bool has_owner = false;
	uint64_t owner = 0;
	ce_event ev;
	int32_t r;

	advance(engine);
	while ((r = ce_poll_event(engine, &ev)) == 1) {
		uint64_t t = trace_now();

		switch (ev.kind) {
		case CE_EVENT_PRESENTED:
			trace_latched(t, ev.output, ev.submission);
			has_owner = c->has_on_screen;
			owner = c->on_screen;
			c->has_on_screen = true;
			c->on_screen = ev.submission;
			c->latched++;
			break;
		case CE_EVENT_DROPPED:
			/*
			 * This backend never replaces a pending frame and never
			 * loses the device, so a drop can only be "replaced".
			 */
			trace_dropped(t, ev.output, ev.submission);
			has_owner = true;
			owner = ev.submission;
			c->dropped++;
			break;
		case CE_EVENT_RELEASED:
			trace_released(t, ev.buffer, has_owner, owner);
			break;
		case CE_EVENT_DEVICE_LOST:
			trace_device_lost(t);
			has_owner = false;
			c->has_on_screen = false;
			break;
		case CE_EVENT_CAPABILITIES_CHANGED:
			trace_caps_changed(t);
			break;
		case CE_EVENT_LATCH_TIMEOUT:
			trace_latch_timeout(t, ev.output, ev.submission);
			c->timeouts++;
			break;
		default:
			printk("SCENE_ERROR unknown event kind %u\n", ev.kind);
			return false;
		}
	}
	if (r < 0) {
		printk("SCENE_ERROR ce_poll_event status %" PRId32 "\n", r);
		return false;
	}
	return true;
}

/*
 * Presents one frame and writes its validate and commit lines. Returns the
 * status of ce_present(); *info says why it failed.
 */
static ce_status present(ce_engine *engine, struct scene_backend *be, const ce_layer *layers,
			 size_t count, uint64_t *submission, ce_error_info *info)
{
	const ce_frame frame = { .layers = layers, .layer_count = count, .output = OUT_ID };
	uint64_t start, done;
	ce_status s;

	be->accepted = false;
	be->accepted_count = 0;
	be->rejected = 0;
	be->committed = false;

	advance(engine);
	start = trace_now();
	s = ce_present(engine, &frame, submission, info);
	done = trace_now();

	if (be->accepted) {
		/* Planning succeeded; the core traced validate ok, then commit. */
		uint64_t plan_end = be->committed ? be->plan_end : done;

		trace_validate_ok(plan_end, OUT_ID, count, be->accepted_assignments,
				  be->accepted_count, trace_ticks(start, plan_end));
		if (s == CE_OK) {
			trace_commit_ok(done, OUT_ID, *submission, trace_ticks(plan_end, done));
		} else if (!trace_commit_err(done, OUT_ID, info, trace_ticks(plan_end, done))) {
			printk("SCENE_ERROR commit status %" PRId32 " has no trace code\n", s);
		}
	} else if (s != CE_OK) {
		if (!trace_validate_err(done, OUT_ID, count, info, be->rejected,
					trace_ticks(start, done))) {
			printk("SCENE_ERROR present status %" PRId32 " has no trace code\n", s);
		}
	}
	return s;
}

static ce_layer make_layer(uint32_t buffer, ce_rect src, ce_rect dst, int32_t z, uint16_t alpha,
			   uint8_t blend)
{
	return (ce_layer){
		.buffer = buffer,
		.source = src,
		.destination = dst,
		.z_order = z,
		.alpha = alpha,
		.blend = blend,
		.transform = CE_TRANSFORM_NORMAL,
	};
}

static size_t scene_layers(unsigned int slot, ce_layer *out)
{
	const ce_rect full = { 0, 0, OUT_W, OUT_H };
	const ce_rect top_src = { 0, 0, TOP_W, TOP_H };
	const ce_rect top_dst = { TOP_X, TOP_Y, TOP_W, TOP_H };

	out[0] = make_layer(slot_base[slot], full, full, 0, CE_ALPHA_OPAQUE, CE_BLEND_OPAQUE);
	if (LAYERS > 1) {
		out[1] = make_layer(slot_top[slot], top_src, top_dst, 1,
				    CONFIG_IMX95_M7_SCENE_TOP_ALPHA, CE_BLEND_PREMULTIPLIED);
	}
	return LAYERS;
}

/*
 * Polls until every buffer of the frame may be shown again, then marks the
 * ones the producer holds as drawn (the pixels never change). Returns false
 * on a timeout or an engine error.
 */
static bool make_ready(ce_engine *engine, struct counters *c, const ce_layer *layers,
		       size_t count)
{
	int64_t deadline = k_uptime_get() + CONFIG_IMX95_M7_SCENE_LATCH_TIMEOUT_MS;

	for (size_t i = 0; i < count; i++) {
		int32_t state;

		while ((state = ce_buffer_state(engine, layers[i].buffer)) == CE_BUFFER_SUBMITTED ||
		       state == CE_BUFFER_SCANNING) {
			if (!drain(engine, c) || c->timeouts > 0) {
				return false;
			}
			if (k_uptime_get() > deadline) {
				printk("SCENE_ERROR buffer %" PRIu32 " not released in %d ms\n",
				       layers[i].buffer, CONFIG_IMX95_M7_SCENE_LATCH_TIMEOUT_MS);
				return false;
			}
			k_yield();
		}
		if (state == CE_BUFFER_WRITABLE) {
			ce_status s = ce_finish_write(engine, layers[i].buffer);

			if (s != CE_OK) {
				printk("SCENE_ERROR ce_finish_write(%" PRIu32 ") status %" PRId32 "\n",
				       layers[i].buffer, s);
				return false;
			}
		}
	}
	return true;
}

static void print_scene(void)
{
	printk("SCENE layer=base buffer=%" PRIu32 ",%" PRIu32 " format=AR24 src=0,0,%ux%u"
	       " dst=0,0,%ux%u zorder=0 blend=opaque alpha=0x%04x\n",
	       slot_base[0], slot_base[1], OUT_W, OUT_H, OUT_W, OUT_H, CE_ALPHA_OPAQUE);
	if (LAYERS > 1) {
		printk("SCENE layer=top buffer=%" PRIu32 ",%" PRIu32 " format=AR24 src=0,0,%ux%u"
		       " dst=%u,%u,%ux%u zorder=1 blend=premultiplied alpha=0x%04x\n",
		       slot_top[0], slot_top[1], TOP_W, TOP_H, TOP_X, TOP_Y, TOP_W, TOP_H,
		       CONFIG_IMX95_M7_SCENE_TOP_ALPHA);
	}
}

static _Alignas(CE_ENGINE_ALIGN) unsigned char engine_storage[CE_ENGINE_SIZE];

int main(void)
{
	static const ce_backend_ops ops = {
		.capabilities = scene_capabilities,
		.check = scene_check,
		.commit = scene_commit,
		.poll_event = scene_poll_event,
	};
	static struct scene_backend be;
	static struct counters c;
	const char *verdict = "DONE";
	const char *reason = "";
	uint32_t frames = 0;

	printk("SCENE_APP imx95_m7_scene board=%s stage=%s frames=%d latch=%s trace=%s\n",
	       CONFIG_BOARD_TARGET, STAGE_TEXT, CONFIG_IMX95_M7_SCENE_FRAMES, LATCH_TEXT,
	       trace_buffered() ? "buffered" : "live");
	print_scene();
	printk("SCENE_NOTE prepend '# date: YYYY-MM-DD' (the run date) to the captured log"
	       " for scripts/trace-to-metrics.py\n");
	if (IS_ENABLED(CONFIG_IMX95_M7_SCENE_STUB_LATCH)) {
		printk("SCENE_NOTE latch=stub: no display is driven; latched lines are not"
		       " display events and this log is not a comparison result\n");
	}

	if (!CE_ABI_CHECK()) {
		printk("VERDICT m2scene-zephyr: FAIL ce_abi_check\n");
		return 0;
	}

#if defined(CONFIG_IMX95_M7_SCENE_ENABLE_DPU)
	be.dev = DEVICE_DT_GET(DISP_NODE);
	if (!device_is_ready(be.dev)) {
		printk("VERDICT m2scene-zephyr: FAIL display device not ready\n");
		return 0;
	}
	struct display_capabilities caps;

	display_get_capabilities(be.dev, &caps);
	if (caps.x_resolution != OUT_W || caps.y_resolution != OUT_H ||
	    caps.current_pixel_format != PIXEL_FORMAT_ARGB_8888) {
		printk("VERDICT m2scene-zephyr: FAIL display is %ux%u format 0x%x, not the"
		       " overlay's\n", caps.x_resolution, caps.y_resolution,
		       caps.current_pixel_format);
		return 0;
	}
	/* Static pixels, as the Linux side: every frame shows the same picture. */
	for (size_t i = 0; i < ARRAY_SIZE(fb[0]); i++) {
		fb[0][i] = COLOR_BASE;
		fb[1][i] = COLOR_BASE;
	}
#endif

	ce_engine *engine = ce_engine_init(engine_storage, sizeof(engine_storage), &ops, &be);

	if (engine == NULL) {
		printk("VERDICT m2scene-zephyr: FAIL ce_engine_init\n");
		return 0;
	}

	const ce_buffer_info base_info = { CE_MODIFIER_LINEAR, OUT_W, OUT_H, CE_FORMAT_ARGB8888 };
	const ce_buffer_info top_info = { CE_MODIFIER_LINEAR, TOP_W, TOP_H, CE_FORMAT_ARGB8888 };

	for (unsigned int s = 0; s < 2; s++) {
		if (ce_register_buffer(engine, slot_base[s], &base_info) != CE_OK ||
		    (LAYERS > 1 && ce_register_buffer(engine, slot_top[s], &top_info) != CE_OK)) {
			printk("VERDICT m2scene-zephyr: FAIL ce_register_buffer\n");
			return 0;
		}
	}

	uint64_t timeout = (uint64_t)trace_freq_hz() * CONFIG_IMX95_M7_SCENE_LATCH_TIMEOUT_MS / 1000;

	ce_set_latch_timeout(engine, timeout);
	trace_engine_time();

	char board[64];

	/* The Zephyr board target, not a measured SoC identity. */
	snprintk(board, sizeof(board), "zephyr %s latch=%s", CONFIG_BOARD_TARGET, LATCH_TEXT);
	/* build= names both sources: this repository and the Zephyr tree. */
	trace_hdr("hwlayer-manager " SCENE_REPO_REV " zephyr " STRINGIFY(BUILD_VERSION), board);

	for (frames = 0; frames < CONFIG_IMX95_M7_SCENE_FRAMES; frames++) {
		ce_layer layers[LAYERS];
		size_t count = scene_layers(frames & 1U, layers);
		ce_error_info info = { 0 };
		uint64_t submission = 0;
		ce_status s;

		if (!make_ready(engine, &c, layers, count)) {
			verdict = "FAIL";
			reason = c.timeouts > 0 ? "latch timeout" : "buffer not released";
			break;
		}
		s = present(engine, &be, layers, count, &submission, &info);
		if (s != CE_OK) {
			/*
			 * Stage B is expected to stop here on the stock driver:
			 * the second layer finds the only plane taken.
			 */
			verdict = IS_ENABLED(CONFIG_IMX95_M7_SCENE_STAGE_B) &&
						  s == CE_ERR_NO_PLANE
					  ? "BLOCKED"
					  : "FAIL";
			reason = s == CE_ERR_NO_PLANE ? "plan.no_plane (see the validate line)"
						      : "ce_present failed (see the trace)";
			break;
		}
		c.committed++;
		if (!drain(engine, &c)) {
			verdict = "FAIL";
			reason = "ce_poll_event";
			break;
		}
	}

	/* Wait for the last submission's latch, as the frame loop would. */
	int64_t deadline = k_uptime_get() + CONFIG_IMX95_M7_SCENE_LATCH_TIMEOUT_MS;

	while (strcmp(verdict, "DONE") == 0 && c.latched + c.dropped < c.committed) {
		if (!drain(engine, &c)) {
			verdict = "FAIL";
			reason = "ce_poll_event";
		} else if (c.timeouts > 0 || k_uptime_get() > deadline) {
			verdict = "FAIL";
			reason = "latch timeout";
		}
		k_yield();
	}

	trace_flush();
	if (strcmp(verdict, "DONE") == 0 && trace_lost() > 0) {
		verdict = "FAIL";
		reason = "trace lines lost (raise CONFIG_IMX95_M7_SCENE_TRACE_BUFFER_KB)";
	}
	printk("RESULT frames=%u committed=%u latched=%u dropped=%u timeouts=%u trace_lost=%u\n",
	       frames, c.committed, c.latched, c.dropped, c.timeouts, trace_lost());
	printk("VERDICT m2scene-zephyr: %s%s%s\n", verdict, reason[0] ? " " : "", reason);
	return 0;
}
```

## src/trace.c
```c
/*
 * SPDX-License-Identifier: Apache-2.0
 *
 * CETRACE v=1 line writer (docs/trace-format.md). Field order and error
 * codes follow crates/composition-trace/src/format.rs, so the strict parser
 * of that crate reads these lines.
 */
#include "trace.h"

#include <zephyr/kernel.h>
#include <zephyr/sys/printk.h>
#include <zephyr/sys/util.h>

#include <inttypes.h>
#include <stdarg.h>
#include <string.h>

#if defined(CONFIG_TIMER_HAS_64BIT_CYCLE_COUNTER)
#define CLOCK_64 1
#else
#define CLOCK_64 0
#endif

/* One line; 16 assignments of about 60 characters fit. */
#define LINE_MAX 1280

static uint64_t seq;
static uint64_t at;
static uint32_t lost;
static char line[LINE_MAX];
static size_t line_len;

#if CONFIG_IMX95_M7_SCENE_TRACE_BUFFER_KB > 0
static char ring[CONFIG_IMX95_M7_SCENE_TRACE_BUFFER_KB * 1024];
static size_t ring_len;
#endif

uint64_t trace_now(void)
{
#if CLOCK_64
	return k_cycle_get_64();
#else
	return k_cycle_get_32();
#endif
}

uint64_t trace_ticks(uint64_t a, uint64_t b)
{
#if CLOCK_64
	return b - a;
#else
	return (uint32_t)((uint32_t)b - (uint32_t)a);
#endif
}

uint64_t trace_engine_time(void)
{
#if CLOCK_64
	return k_cycle_get_64();
#else
	static uint64_t ext;
	static uint32_t last;
	uint32_t now = k_cycle_get_32();

	ext += (uint32_t)(now - last);
	last = now;
	return ext;
#endif
}

uint32_t trace_freq_hz(void)
{
	return sys_clock_hw_cycles_per_sec();
}

const char *trace_clock_name(void)
{
	return CLOCK_64 ? "cyc64" : "cyc32";
}

void trace_set_at(uint64_t engine_time)
{
#if CLOCK_64
	at = engine_time;
#else
	/* at= is on the same raw 32-bit counter as t= (at_unit=same). */
	at = (uint32_t)engine_time;
#endif
}

static void put(const char *fmt, ...)
{
	va_list ap;
	int n;

	if (line_len >= sizeof(line)) {
		return;
	}
	va_start(ap, fmt);
	n = vsnprintk(line + line_len, sizeof(line) - line_len, fmt, ap);
	va_end(ap);
	line_len = n < 0 ? sizeof(line) : MIN(line_len + (size_t)n, sizeof(line));
}

static void begin(const char *ev, uint64_t t)
{
	line_len = 0;
	put("CETRACE v=1 ev=%s seq=%" PRIu64 " t=%" PRIu64 " at=%" PRIu64, ev, seq, t, at);
}

/* Ends the line. Every line takes a seq, also one that is lost. */
static void end(void)
{
	seq++;
	if (line_len + 1 >= sizeof(line)) {
		/* Truncated: never write a partial line. */
		lost++;
		return;
	}
	line[line_len++] = '\n';
	line[line_len] = '\0';
#if CONFIG_IMX95_M7_SCENE_TRACE_BUFFER_KB > 0
	if (ring_len + line_len > sizeof(ring)) {
		lost++;
		return;
	}
	memcpy(ring + ring_len, line, line_len);
	ring_len += line_len;
#else
	printk("%s", line);
#endif
}

static void put_rect(const ce_rect *r)
{
	put("%" PRId32 ",%" PRId32 ",%" PRIu32 ",%" PRIu32, r->x, r->y, r->width, r->height);
}

static void put_assignments(const ce_assignment *a, size_t n)
{
	put(" n=%u assign=", (unsigned int)n);
	if (n == 0) {
		put("-");
		return;
	}
	for (size_t i = 0; i < n; i++) {
		put("%s%" PRIu32 ":%" PRIu32 ":%" PRIu32 ":%" PRId32 ":", i == 0 ? "" : ";",
		    a[i].layer, a[i].plane, a[i].plane_index, a[i].zpos);
		put_rect(&a[i].source);
		put(":");
		put_rect(&a[i].destination);
	}
}

/*
 * A BackendError, as a check result ("rejected") or nested in an Error
 * ("backend.rejected"). Returns false for a status that is not one.
 */
static bool put_backend_error(const ce_error_info *e, const char *prefix)
{
	switch (e->status) {
	case CE_ERR_BACKEND_REJECTED:
		put("%srejected", prefix);
		return true;
	case CE_ERR_BACKEND_BUSY:
		put("%sbusy", prefix);
		return true;
	case CE_ERR_BACKEND_UNKNOWN_BUFFER:
		put("%sunknown_buffer buf=%" PRIu32, prefix, e->buffer);
		return true;
	case CE_ERR_DEVICE_LOST:
		put("%sdevice_lost", prefix);
		return true;
	case CE_ERR_BACKEND_PLATFORM:
		put("%splatform errno=%" PRId32, prefix, e->platform);
		return true;
	default:
		return false;
	}
}

void trace_hdr(const char *build, const char *board)
{
	line_len = 0;
	put("CETRACE v=1 ev=hdr seq=%" PRIu64 " src=zephyr clock=%s freq_hz=%" PRIu32
	    " t0=%" PRIu64 " at_unit=same build=\"%s\" board=\"%s\"",
	    seq, trace_clock_name(), trace_freq_hz(), trace_now(), build, board);
	end();
}

void trace_check(uint64_t t, uint32_t out, const ce_assignment *a, size_t n, ce_status result)
{
	ce_error_info e = { .status = result };

	begin("check", t);
	put(" out=%" PRIu32, out);
	put_assignments(a, n);
	put(" result=");
	if (result == CE_OK) {
		put("ok");
	} else if (!put_backend_error(&e, "")) {
		/* The backend returns its own errno-style codes as platform errors. */
		put("platform errno=%" PRId32, result);
	}
	end();
}

void trace_validate_ok(uint64_t t, uint32_t out, size_t layers, const ce_assignment *a, size_t n,
		       uint64_t dur)
{
	begin("validate", t);
	put(" out=%" PRIu32 " layers=%u", out, (unsigned int)layers);
	put_assignments(a, n);
	put(" result=ok dur=%" PRIu64, dur);
	end();
}

bool trace_validate_err(uint64_t t, uint32_t out, size_t layers, const ce_error_info *info,
			uint32_t candidates, uint64_t dur)
{
	begin("validate", t);
	put(" out=%" PRIu32 " layers=%u result=", out, (unsigned int)layers);
	switch (info->status) {
	case CE_ERR_UNKNOWN_OUTPUT:
		put("plan.unknown_output err_out=%" PRIu32, out);
		break;
	case CE_ERR_TOO_MANY_LAYERS:
		put("plan.too_many_layers count=%u", (unsigned int)layers);
		break;
	case CE_ERR_UNKNOWN_BUFFER:
		put("plan.unknown_buffer layer=%" PRIu32 " buf=%" PRIu32, info->layer, info->buffer);
		break;
	case CE_ERR_INVALID_SOURCE:
		put("plan.invalid_source layer=%" PRIu32, info->layer);
		break;
	case CE_ERR_INVALID_DESTINATION:
		put("plan.invalid_destination layer=%" PRIu32, info->layer);
		break;
	case CE_ERR_CANNOT_CLIP:
		put("plan.cannot_clip layer=%" PRIu32, info->layer);
		break;
	case CE_ERR_NO_PLANE:
		put("plan.no_plane layer=%" PRIu32 " reasons=0x%" PRIx32, info->layer,
		    info->reasons);
		break;
	case CE_ERR_BACKEND_REJECTED:
		/* Every candidate was rejected by check. */
		put("plan.backend_rejected candidates=%" PRIu32, candidates);
		break;
	case CE_ERR_SEARCH_LIMIT:
		put("plan.limit_exceeded");
		break;
	default:
		/* A check that failed with something else ends the search. */
		if (!put_backend_error(info, "backend.")) {
			line_len = 0;
			return false;
		}
		break;
	}
	put(" dur=%" PRIu64, dur);
	end();
	return true;
}

void trace_commit_ok(uint64_t t, uint32_t out, uint64_t sub, uint64_t dur)
{
	begin("commit", t);
	put(" out=%" PRIu32 " result=ok sub=%" PRIu64 " dur=%" PRIu64, out, sub, dur);
	end();
}

bool trace_commit_err(uint64_t t, uint32_t out, const ce_error_info *info, uint64_t dur)
{
	begin("commit", t);
	put(" out=%" PRIu32 " result=", out);
	switch (info->status) {
	case CE_ERR_UNKNOWN_BUFFER:
		put("present.unknown_buffer buf=%" PRIu32, info->buffer);
		break;
	case CE_ERR_DUPLICATE_BUFFER:
		put("present.duplicate_buffer buf=%" PRIu32, info->buffer);
		break;
	case CE_ERR_BUFFER_TABLE_FULL:
		put("present.buffer_table_full");
		break;
	case CE_ERR_BUFFER_IN_USE:
		put("present.buffer_in_use buf=%" PRIu32, info->buffer);
		break;
	case CE_ERR_BUFFER_NOT_READY:
		put("present.buffer_not_ready buf=%" PRIu32, info->buffer);
		break;
	case CE_ERR_BUFFER_NOT_WRITABLE:
		put("present.buffer_not_writable buf=%" PRIu32, info->buffer);
		break;
	case CE_ERR_BUSY:
		/* The engine only presents one frame per output at a time. */
		put("present.busy err_out=%" PRIu32, out);
		break;
	case CE_ERR_TOO_MANY_OUTPUTS:
		put("present.too_many_outputs");
		break;
	case CE_ERR_TOO_MANY_BUFFERS:
		put("present.too_many_buffers");
		break;
	case CE_ERR_EVENT_QUEUE_FULL:
		put("present.event_queue_full");
		break;
	default:
		/*
		 * Not representable: CE_ERR_UNEXPECTED_LATCH (the C ABI does
		 * not say which output and submission), CE_ERR_INVALID_ARGUMENT,
		 * and anything unknown. The caller prints a plain line instead.
		 */
		if (!put_backend_error(info, "backend.")) {
			line_len = 0;
			return false;
		}
		break;
	}
	put(" dur=%" PRIu64, dur);
	end();
	return true;
}

void trace_latched(uint64_t t, uint32_t out, uint64_t sub)
{
	begin("latched", t);
	put(" out=%" PRIu32 " sub=%" PRIu64, out, sub);
	end();
}

void trace_released(uint64_t t, uint32_t buf, bool has_sub, uint64_t sub)
{
	begin("released", t);
	if (has_sub) {
		put(" buf=%" PRIu32 " sub=%" PRIu64, buf, sub);
	} else {
		put(" buf=%" PRIu32 " sub=-", buf);
	}
	end();
}

void trace_dropped(uint64_t t, uint32_t out, uint64_t sub)
{
	begin("dropped", t);
	put(" out=%" PRIu32 " sub=%" PRIu64 " reason=replaced", out, sub);
	end();
}

void trace_latch_timeout(uint64_t t, uint32_t out, uint64_t sub)
{
	begin("latch_timeout", t);
	put(" out=%" PRIu32 " sub=%" PRIu64, out, sub);
	end();
}

void trace_device_lost(uint64_t t)
{
	begin("device_lost", t);
	end();
}

void trace_caps_changed(uint64_t t)
{
	begin("caps_changed", t);
	end();
}

void trace_flush(void)
{
#if CONFIG_IMX95_M7_SCENE_TRACE_BUFFER_KB > 0
	size_t start = 0;

	for (size_t i = 0; i < ring_len; i++) {
		if (ring[i] == '\n') {
			printk("%.*s\n", (int)(i - start), ring + start);
			start = i + 1;
		}
	}
	ring_len = 0;
#endif
}

uint32_t trace_lost(void)
{
	return lost;
}

bool trace_buffered(void)
{
	return CONFIG_IMX95_M7_SCENE_TRACE_BUFFER_KB > 0;
}
```

## src/trace.h
```c
/*
 * SPDX-License-Identifier: Apache-2.0
 *
 * docs/trace-format.md (CETRACE v=1) lines, written from C.
 *
 * The C ABI of the engine has no trace hook, so the application writes the
 * lines itself from what it sees around ce_present() and ce_poll_event(),
 * in the field order of crates/composition-trace/src/format.rs. main.c
 * explains which call produces which line.
 */
#ifndef IMX95_M7_SCENE_TRACE_H_
#define IMX95_M7_SCENE_TRACE_H_

#include <stdbool.h>
#include <stddef.h>
#include <stdint.h>

#include "composition_engine.h"

/* Reads the trace clock: the raw counter value written as t= (and t0=). */
uint64_t trace_now(void);
/*
 * Ticks from a to b, both trace_now() values. Modulo 2^32 for the 32-bit
 * clock, so it survives one wrap.
 */
uint64_t trace_ticks(uint64_t a, uint64_t b);
/*
 * A non-decreasing 64-bit version of the clock for ce_advance_time(). For
 * the 32-bit clock it must be called at least once per counter wrap.
 */
uint64_t trace_engine_time(void);
/* Ticks per second of the trace clock, read from the running system. */
uint32_t trace_freq_hz(void);
/* "cyc64" or "cyc32". */
const char *trace_clock_name(void);

/* The at= value of the following lines: the last ce_advance_time() value. */
void trace_set_at(uint64_t engine_time);

void trace_hdr(const char *build, const char *board);
void trace_check(uint64_t t, uint32_t out, const ce_assignment *a, size_t n, ce_status result);
void trace_validate_ok(uint64_t t, uint32_t out, size_t layers, const ce_assignment *a, size_t n,
		       uint64_t dur);
/* Returns false (and writes nothing) if the status has no trace code. */
bool trace_validate_err(uint64_t t, uint32_t out, size_t layers, const ce_error_info *info,
			uint32_t candidates, uint64_t dur);
void trace_commit_ok(uint64_t t, uint32_t out, uint64_t sub, uint64_t dur);
/* Returns false (and writes nothing) if the status has no trace code. */
bool trace_commit_err(uint64_t t, uint32_t out, const ce_error_info *info, uint64_t dur);
void trace_latched(uint64_t t, uint32_t out, uint64_t sub);
void trace_released(uint64_t t, uint32_t buf, bool has_sub, uint64_t sub);
void trace_dropped(uint64_t t, uint32_t out, uint64_t sub);
void trace_latch_timeout(uint64_t t, uint32_t out, uint64_t sub);
void trace_device_lost(uint64_t t);
void trace_caps_changed(uint64_t t);

/* Prints the buffered lines, if any (CONFIG_IMX95_M7_SCENE_TRACE_BUFFER_KB). */
void trace_flush(void);
/* Lines that did not fit into the buffer; each one is a gap in seq=. */
uint32_t trace_lost(void);
/* true if lines go to a buffer and are printed by trace_flush(). */
bool trace_buffered(void);

#endif /* IMX95_M7_SCENE_TRACE_H_ */
```
