/* SPDX-License-Identifier: Apache-2.0 */

/*
 * Enable the DPU node of the i.MX95 M7 and give it a panel description, as
 * tests/board/imx95_m7_scanout does. The application reads width, height and
 * the display-timings child from this node and its reg and interrupt.
 * The timing is plain 640x480@60 (VESA), a placeholder chosen to be small;
 * it is not the timing of any panel on any board. The node being enabled
 * does not touch the DPU: no Zephyr driver for it is built (see Kconfig),
 * and the application only programs it when
 * CONFIG_IMX95_M7_LATCH_ENABLE_DPU is set.
 */

#include <zephyr/dt-bindings/display/panel.h>

&dpu {
	status = "okay";
	width = <640>;
	height = <480>;
	pixel-format = <PANEL_PIXEL_FORMAT_ARGB_8888>;

	display-timings {
		compatible = "zephyr,panel-timing";
		clock-frequency = <25175000>;
		hfront-porch = <16>;
		hback-porch = <48>;
		hsync-len = <96>;
		vfront-porch = <10>;
		vback-porch = <33>;
		vsync-len = <2>;
		hsync-active = <1>;
		vsync-active = <1>;
		de-active = <0>;
		pixelclk-active = <0>;
	};
};
